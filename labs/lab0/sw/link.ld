/* ============================================================
 * link.ld —— Lab 0 裸机链接脚本
 *
 * 把整个程序放在地址 0 开始的连续空间里，_start 必须在最前面
 * （Makefile 里有断言检查这一点）。
 *
 * 注意：Lab 0 的 CPU 是 Harvard 结构（指令内存 / 数据内存分开）。
 * 所以 .text 里的东西被装进 imem，用 lw 是读不到的。
 * 测试数据一律在程序运行时用 sw 现写进 dmem，不要定义初始化数组。
 * ============================================================ */

OUTPUT_ARCH(riscv)
ENTRY(_start)

SECTIONS
{
  . = 0x00000000;

  .text : {
    *(.text._start)     /* 如果你把 _start 放进独立段，保证它在地址 0 */
    *(.text*)
    *(.rodata*)         /* 只读常量也放这里（同样：只能取指，不能 lw）*/
  }
}
